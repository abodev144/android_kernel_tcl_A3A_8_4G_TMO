## drivers/misc/mediatek/psensor/Kconfig
```kconfig
config MTK_PSENSOR_IQS128
	bool "MTK_Psensor for MediaTek package"
	default n
	help
	  If this option is set,it will support iqs128 psensor driver.
```

## drivers/misc/mediatek/robust/Kconfig
```kconfig
config TCT_ROBUST
    bool "Robust test for TMC"
    default n
    help
      Select this if you need support robust app test
```
